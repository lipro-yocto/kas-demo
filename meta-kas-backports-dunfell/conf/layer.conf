## meta-kas-backports-dunfell/conf/layer.conf
```bitbake
# We have a conf and classes directory, append to BBPATH
BBPATH .= ":${LAYERDIR}"

BBFILES += "${LAYERDIR}/recipes*/*/*.bb ${LAYERDIR}/recipes*/*/*.bbappend"

BBFILE_COLLECTIONS += "meta-kas-backports-dunfell"
BBFILE_PATTERN_meta-kas-backports-dunfell := "^${LAYERDIR}/"
BBFILE_PRIORITY_meta-kas-backports-dunfell = "6"

LAYERVERSION_meta-kas-backports-dunfell = "1"
LAYERSERIES_COMPAT_meta-kas-backports-dunfell = "dunfell"
```

## meta-kas-bsp/conf/layer.conf
```bitbake
# We have a conf and classes directory, append to BBPATH
BBPATH .= ":${LAYERDIR}"

BBFILES += "${LAYERDIR}/recipes*/*/*.bb ${LAYERDIR}/recipes*/*/*.bbappend"

BBFILE_COLLECTIONS += "meta-kas-bsp"
BBFILE_PATTERN_meta-kas-bsp := "^${LAYERDIR}/"
BBFILE_PRIORITY_meta-kas-bsp = "6"

LAYERVERSION_meta-kas-bsp = "1"
LAYERSERIES_COMPAT_meta-kas-bsp = "dunfell honister"
```

## meta-kas-distro/conf/layer.conf
```bitbake
# We have a conf and classes directory, append to BBPATH
BBPATH .= ":${LAYERDIR}"

BBFILES += "${LAYERDIR}/recipes*/*/*.bb ${LAYERDIR}/recipes*/*/*.bbappend"

BBFILE_COLLECTIONS += "meta-kas-distro"
BBFILE_PATTERN_meta-kas-distro := "^${LAYERDIR}/"
BBFILE_PRIORITY_meta-kas-distro = "6"

LAYERVERSION_meta-kas-distro = "1"
LAYERSERIES_COMPAT_meta-kas-distro = "dunfell honister"
```

## meta-kas-ossfix/conf/layer.conf
```bitbake
# We have a conf and classes directory, append to BBPATH
BBPATH .= ":${LAYERDIR}"

BBFILES += "${LAYERDIR}/recipes*/*/*.bb ${LAYERDIR}/recipes*/*/*.bbappend"

BBFILE_COLLECTIONS += "meta-kas-ossfix"
BBFILE_PATTERN_meta-kas-ossfix := "^${LAYERDIR}/"
BBFILE_PRIORITY_meta-kas-ossfix = "6"

LAYERVERSION_meta-kas-ossfix = "1"
LAYERSERIES_COMPAT_meta-kas-ossfix = "dunfell honister"
```
